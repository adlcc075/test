
R.S CPSR 0x1d3 

TERM.METHOD dcc3
TERM.Mode ascii
TERM.SIZE 1024. 1024
TERM.SCROLL on
TERM.VIEW

